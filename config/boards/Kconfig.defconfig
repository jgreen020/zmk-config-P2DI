## config/boards/Kconfig.defconfig
```kconfig
if SHIELD_P2DI_RIGHT

# Name must be less than 16 characters long!
config ZMK_KEYBOARD_NAME
    default "P2DI"

config ZMK_SPLIT_ROLE_CENTRAL
    default y

endif

if SHIELD_P2DI_LEFT || SHIELD_P2DI_RIGHT

config ZMK_SPLIT
    default y

endif
```

## config/boards/shields/Kconfig.shield
```kconfig
# No whitespace after the comma or in your part name!
config SHIELD_P2DI_LEFT
    def_bool $(shields_list_contains,p2di_left)

# No whitespace after the comma or in your part name!
config SHIELD_P2DI_RIGHT
    def_bool $(shields_list_contains,p2di_right)
```
